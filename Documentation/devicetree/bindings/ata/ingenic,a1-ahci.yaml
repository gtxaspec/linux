## Documentation/devicetree/bindings/mmc/ingenic,t32-sdhci.yaml
```yaml
# SPDX-License-Identifier: (GPL-2.0-only OR BSD-2-Clause)
%YAML 1.2
---
$id: http://devicetree.org/schemas/mmc/ingenic,t32-sdhci.yaml#
$schema: http://devicetree.org/meta-schemas/core.yaml#

title: Ingenic T32 and T33 SDHCI controller

maintainers:
  - Alfonso Gamboa <gtxent@gmail.com>

description:
  The MSC controllers of the Ingenic T32 and T33 are SDHCI hosts whose card
  clock comes from the CGU's MSC clock rather than the SDHCI divider.

allOf:
  - $ref: sdhci-common.yaml#

properties:
  compatible:
    oneOf:
      - const: ingenic,t32-sdhci
      - items:
          - enum:
              - ingenic,t32pro-sdhci
              - ingenic,t33-sdhci
          - const: ingenic,t32-sdhci
      - items:
          - enum:
              - ingenic,a1-sdhci
              - ingenic,t40-sdhci
              - ingenic,t41-sdhci
          - const: ingenic,t32-sdhci

  reg:
    maxItems: 1

  interrupts:
    maxItems: 1

  clocks:
    items:
      - description: MSC clock from the CGU, the card clock
      - description: external crystal, the MSC clock's source for the
          identification rates

  clock-names:
    items:
      - const: mmc
      - const: ext

required:
  - compatible
  - reg
  - interrupts
  - clocks
  - clock-names

unevaluatedProperties: false

examples:
  - |
    #include <dt-bindings/clock/ingenic,t32-cgu.h>

    mmc@13060000 {
      compatible = "ingenic,t32-sdhci";
      reg = <0x13060000 0x10000>;

      interrupt-parent = <&intc>;
      interrupts = <37>;

      clocks = <&cgu T32_CLK_MSC0>, <&cgu T32_CLK_EXCLK>;
      clock-names = "mmc", "ext";

      bus-width = <4>;
      no-1-8-v;
    };
```

## Documentation/devicetree/bindings/net/ingenic,mac.yaml
```yaml
# SPDX-License-Identifier: (GPL-2.0-only OR BSD-2-Clause)
%YAML 1.2
---
$id: http://devicetree.org/schemas/net/ingenic,mac.yaml#
$schema: http://devicetree.org/meta-schemas/core.yaml#

title: MAC in Ingenic SoCs

maintainers:
  - 周琰杰 (Zhou Yanjie) <zhouyanjie@wanyeetech.com>

description:
  The Ethernet Media Access Controller in Ingenic SoCs.

allOf:
  - $ref: snps,dwmac.yaml#

properties:
  compatible:
    oneOf:
      - enum:
          - ingenic,jz4775-mac
          - ingenic,x1000-mac
          - ingenic,x1600-mac
          - ingenic,x1830-mac
          - ingenic,x2000-mac
      - items:
          - enum:
              - ingenic,t21-mac
              - ingenic,t23-mac
              - ingenic,t30-mac
              - ingenic,t31-mac
              - ingenic,t32-mac
          - const: snps,dwmac
      - items:
          - const: ingenic,t33-mac
          - const: ingenic,t32-mac
          - const: snps,dwmac

  reg:
    maxItems: 1

  interrupts:
    maxItems: 1

  interrupt-names:
    const: macirq

  clocks:
    maxItems: 1

  clock-names:
    const: stmmaceth

  mode-reg:
    $ref: /schemas/types.yaml#/definitions/phandle
    description: An extra syscon register that control ethernet interface and timing delay

  ingenic,phy-id-reg:
    $ref: /schemas/types.yaml#/definitions/phandle
    description:
      Syscon of the CPM MAC PHY parameter register (MACPHYP), which holds the
      identifier that the SoC's internal PHY reports on MDIO.

  rx-clk-delay-ps:
    description: RGMII receive clock delay defined in pico seconds

  tx-clk-delay-ps:
    description: RGMII transmit clock delay defined in pico seconds

required:
  - compatible
  - reg
  - interrupts
  - interrupt-names
  - clocks
  - clock-names
  - mode-reg

if:
  properties:
    compatible:
      contains:
        const: ingenic,t21-mac
then:
  required:
    - ingenic,phy-id-reg
else:
  properties:
    ingenic,phy-id-reg: false

unevaluatedProperties: false

examples:
  - |
    #include <dt-bindings/clock/ingenic,x1000-cgu.h>

    mac: ethernet@134b0000 {
        compatible = "ingenic,x1000-mac";
        reg = <0x134b0000 0x2000>;

        interrupt-parent = <&intc>;
        interrupts = <55>;
        interrupt-names = "macirq";

        clocks = <&cgu X1000_CLK_MAC>;
        clock-names = "stmmaceth";

        mode-reg = <&mac_phy_ctrl>;

        phy-mode = "rmii";
    };
...
```

## Documentation/devicetree/bindings/nvmem/ingenic,jz4780-efuse.yaml
```yaml
# SPDX-License-Identifier: GPL-2.0-only OR BSD-2-Clause
%YAML 1.2
---
$id: http://devicetree.org/schemas/nvmem/ingenic,jz4780-efuse.yaml#
$schema: http://devicetree.org/meta-schemas/core.yaml#

title: Ingenic JZ EFUSE driver

maintainers:
  - PrasannaKumar Muralidharan <prasannatsmkumar@gmail.com>

allOf:
  - $ref: nvmem.yaml#

properties:
  compatible:
    enum:
      - ingenic,jz4780-efuse
      - ingenic,t10-efuse
      - ingenic,t20-efuse
      - ingenic,t21-efuse
      - ingenic,t23-efuse
      - ingenic,t30-efuse
      - ingenic,t31-efuse
      - ingenic,t32-efuse
      - ingenic,t33-efuse

  reg:
    maxItems: 1

  clocks:
    # Handle for the ahb for the efuse.
    maxItems: 1

required:
  - compatible
  - reg
  - clocks

unevaluatedProperties: false

examples:
  - |
    #include <dt-bindings/clock/ingenic,jz4780-cgu.h>

    efuse@134100d0 {
        compatible = "ingenic,jz4780-efuse";
        reg = <0x134100d0 0x2c>;

        clocks = <&cgu JZ4780_CLK_AHB2>;
    };

...
```

## Documentation/devicetree/bindings/phy/ingenic,phy-usb.yaml
```yaml
# SPDX-License-Identifier: (GPL-2.0-only OR BSD-2-Clause)
%YAML 1.2
---
$id: http://devicetree.org/schemas/phy/ingenic,phy-usb.yaml#
$schema: http://devicetree.org/meta-schemas/core.yaml#

title: Ingenic SoCs USB PHY

maintainers:
  - Paul Cercueil <paul@crapouillou.net>
  - 周琰杰 (Zhou Yanjie) <zhouyanjie@wanyeetech.com>

select:
  properties:
    compatible:
      contains:
        enum:
          - ingenic,jz4770-phy
          - ingenic,jz4775-phy
          - ingenic,jz4780-phy
          - ingenic,t21-phy
          - ingenic,t23-phy
          - ingenic,t30-phy
          - ingenic,t31-phy
          - ingenic,t32-phy
          - ingenic,t33-phy
          - ingenic,t40-phy
          - ingenic,t41-phy
          - ingenic,x1000-phy
          - ingenic,x1830-phy
          - ingenic,x2000-phy
  required:
    - compatible

properties:
  $nodename:
    pattern: '^usb-phy@.*'

  compatible:
    oneOf:
      - enum:
          - ingenic,jz4770-phy
          - ingenic,jz4775-phy
          - ingenic,jz4780-phy
          - ingenic,t21-phy
          - ingenic,t32-phy
          - ingenic,x1000-phy
          - ingenic,x1830-phy
          - ingenic,x2000-phy
      - items:
          - enum:
              - ingenic,t23-phy
              - ingenic,t30-phy
              - ingenic,t31-phy
          - const: ingenic,t21-phy
      - items:
          - enum:
              - ingenic,t33-phy
              - ingenic,t40-phy
              - ingenic,t41-phy
          - const: ingenic,t32-phy

  reg:
    maxItems: 1
    description:
      The USB PHY control registers of the CPM (USBPCR, USBRDT, USBVBFIL,
      USBPCR1); on the T-series, the PHY's own register block instead.

  clocks:
    maxItems: 1

  vcc-supply:
    description: VCC power supply

  resets:
    maxItems: 1
    description:
      Reset of the OTG controller, held while the PHY leaves power-on reset.

  ingenic,usb-phy-ctrl:
    $ref: /schemas/types.yaml#/definitions/phandle
    description:
      Syscon of the CPM USB PHY control registers (USBPCR, USBRDT, USBVBFIL,
      USBPCR1).

  '#phy-cells':
    const: 0

required:
  - compatible
  - reg
  - clocks
  - vcc-supply
  - '#phy-cells'

allOf:
  - if:
      properties:
        compatible:
          contains:
            enum:
              - ingenic,t21-phy
              - ingenic,t32-phy
    then:
      required:
        - resets
        - ingenic,usb-phy-ctrl
    else:
      properties:
        resets: false
        ingenic,usb-phy-ctrl: false

additionalProperties: false

examples:
  - |
    #include <dt-bindings/clock/ingenic,jz4770-cgu.h>
    otg_phy: usb-phy@3c {
      compatible = "ingenic,jz4770-phy";
      reg = <0x3c 0x10>;

      vcc-supply = <&vcc>;
      clocks = <&cgu JZ4770_CLK_OTG_PHY>;

      #phy-cells = <0>;
    };

  - |
    #include <dt-bindings/clock/ingenic,t32-cgu.h>
    usb-phy@10060000 {
      compatible = "ingenic,t33-phy", "ingenic,t32-phy";
      reg = <0x10060000 0x1000>;

      vcc-supply = <&vcc>;
      clocks = <&cgu T32_CLK_OTGPHY>;
      resets = <&srbc 12>;
      ingenic,usb-phy-ctrl = <&usb_phy_ctrl>;

      #phy-cells = <0>;
    };

  - |
    #include <dt-bindings/clock/ingenic,t31-cgu.h>
    usb-phy@10060000 {
      compatible = "ingenic,t31-phy", "ingenic,t21-phy";
      reg = <0x10060000 0x1000>;

      vcc-supply = <&vcc>;
      clocks = <&cgu T31_CLK_OTGPHY>;
      resets = <&srbc 12>;
      ingenic,usb-phy-ctrl = <&usb_phy_ctrl>;

      #phy-cells = <0>;
    };
```

## Documentation/devicetree/bindings/pwm/ingenic,t32-pwm.yaml
```yaml
# SPDX-License-Identifier: GPL-2.0-only OR BSD-2-Clause
%YAML 1.2
---
$id: http://devicetree.org/schemas/pwm/ingenic,t32-pwm.yaml#
$schema: http://devicetree.org/meta-schemas/core.yaml#

title: Ingenic T32, T33 and T41 PWM controller

maintainers:
  - Paul Cercueil <paul@crapouillou.net>

description:
  The dedicated PWM controller of the T32 and T33 SoCs, with four channels,
  and of the T41, with eight. It is separate from the TCU, whose channels
  have no PWM output pin on these SoCs.

allOf:
  - $ref: pwm.yaml#

properties:
  compatible:
    oneOf:
      - enum:
          - ingenic,t32-pwm
          - ingenic,t41-pwm
      - items:
          - enum:
              - ingenic,t32pro-pwm
              - ingenic,t33-pwm
          - const: ingenic,t32-pwm

  reg:
    maxItems: 1

  clocks:
    maxItems: 1

  "#pwm-cells":
    const: 3

required:
  - compatible
  - reg
  - clocks
  - "#pwm-cells"

unevaluatedProperties: false

examples:
  - |
    #include <dt-bindings/clock/ingenic,t32-cgu.h>

    pwm@13450000 {
        compatible = "ingenic,t32-pwm";
        reg = <0x13450000 0x1000>;

        clocks = <&cgu T32_CLK_PWM>;
        assigned-clocks = <&cgu T32_CLK_PWM>;
        assigned-clock-rates = <50000000>;

        #pwm-cells = <3>;
    };
```

## Documentation/devicetree/bindings/reset/ingenic,t21-reset.yaml
```yaml
# SPDX-License-Identifier: (GPL-2.0-only OR BSD-2-Clause)
%YAML 1.2
---
$id: http://devicetree.org/schemas/reset/ingenic,t21-reset.yaml#
$schema: http://devicetree.org/meta-schemas/core.yaml#

title: Ingenic T-series soft reset controller

maintainers:
  - Alfonso Gamboa <gtxent@gmail.com>

description: |
  The Soft Reset and Bus Control register (SRBC) of the clock and power
  controller in the Ingenic T21, T23, T30, T31, T32 and T33. Setting a reset bit holds
  the block (OTG controller, VPU, ISP) in reset; clearing it releases the
  block. The other bits of the register request bus stops and are not
  resets. The reset specifier is the bit number in SRBC, for example 12 for
  the OTG controller.

properties:
  compatible:
    oneOf:
      - const: ingenic,t21-reset
      - items:
          - enum:
              - ingenic,t23-reset
              - ingenic,t30-reset
              - ingenic,t31-reset
              - ingenic,t32-reset
              - ingenic,t33-reset
              - ingenic,t40-reset
              - ingenic,t41-reset
          - const: ingenic,t21-reset

  reg:
    maxItems: 1

  '#reset-cells':
    const: 1

required:
  - compatible
  - reg
  - '#reset-cells'

additionalProperties: false

examples:
  - |
    reset-controller@c4 {
        compatible = "ingenic,t31-reset", "ingenic,t21-reset";
        reg = <0xc4 0x4>;
        #reset-cells = <1>;
    };
```

## Documentation/devicetree/bindings/rtc/ingenic,a1-rtc.yaml
```yaml
# SPDX-License-Identifier: (GPL-2.0-only OR BSD-2-Clause)
%YAML 1.2
---
$id: http://devicetree.org/schemas/rtc/ingenic,a1-rtc.yaml#
$schema: http://devicetree.org/meta-schemas/core.yaml#

title: Ingenic A1 Real-Time Clock

maintainers:
  - Alfonso Gamboa <gtxent@gmail.com>

description:
  The A1's RTC is a free running seconds counter. It has no register to set
  the time or an alarm, so the driver keeps the offset to the wall time itself.

allOf:
  - $ref: rtc.yaml#

properties:
  compatible:
    const: ingenic,a1-rtc

  reg:
    maxItems: 1

  clocks:
    maxItems: 1

required:
  - compatible
  - reg
  - clocks

unevaluatedProperties: false

examples:
  - |
    #include <dt-bindings/clock/ingenic,a1-cgu.h>

    rtc@10003000 {
        compatible = "ingenic,a1-rtc";
        reg = <0x10003000 0x1000>;
        clocks = <&cgu A1_CLK_RTC>;
    };
```

## Documentation/devicetree/bindings/spi/ingenic,sfc.yaml
```yaml
# SPDX-License-Identifier: (GPL-2.0-only OR BSD-2-Clause)
%YAML 1.2
---
$id: http://devicetree.org/schemas/spi/ingenic,sfc.yaml#
$schema: http://devicetree.org/meta-schemas/core.yaml#

title: Ingenic SoCs SPI flash controller

maintainers:
  - Alfonso Gamboa <gtxent@gmail.com>

description:
  The SFC of Ingenic SoCs, a SPI controller dedicated to serial NOR and
  NAND flash.

allOf:
  - $ref: /schemas/spi/spi-controller.yaml#

properties:
  compatible:
    oneOf:
      - enum:
          - ingenic,x1000-sfc
          - ingenic,t32-sfc
      - items:
          - enum:
              - ingenic,t10-sfc
              - ingenic,t20-sfc
              - ingenic,t21-sfc
              - ingenic,t23-sfc
              - ingenic,t30-sfc
              - ingenic,t31-sfc
          - const: ingenic,x1000-sfc
      - items:
          - const: ingenic,t33-sfc
          - const: ingenic,t32-sfc

  reg:
    maxItems: 1

  interrupts:
    maxItems: 1

  clocks:
    maxItems: 1

  clock-names:
    const: sfc

required:
  - compatible
  - reg
  - interrupts
  - clocks
  - clock-names

unevaluatedProperties: false

examples:
  - |
    #include <dt-bindings/clock/ingenic,t32-cgu.h>

    spi@13440000 {
      compatible = "ingenic,t32-sfc";
      reg = <0x13440000 0x10000>;

      interrupt-parent = <&intc>;
      interrupts = <7>;

      clocks = <&cgu T32_CLK_SFC0>;
      clock-names = "sfc";

      #address-cells = <1>;
      #size-cells = <0>;

      flash@0 {
        compatible = "jedec,spi-nor";
        reg = <0>;
        spi-max-frequency = <25000000>;
      };
    };
```

## Documentation/devicetree/bindings/timer/ingenic,xburst2-ost.yaml
```yaml
# SPDX-License-Identifier: (GPL-2.0-only OR BSD-2-Clause)
%YAML 1.2
---
$id: http://devicetree.org/schemas/timer/ingenic,xburst2-ost.yaml#
$schema: http://devicetree.org/meta-schemas/core.yaml#

title: OSTs in Ingenic XBurst2 SoCs

maintainers:
  - Alfonso Gamboa <gtxent@gmail.com>

description:
  The XBurst2 SoCs have one 64-bit global OST, used as clocksource, and a
  32-bit OST in a register window of its own for every core, used as that
  core's clockevent. The core OST of a core interrupts that core only, on CPU
  interrupt pin 4, once the core's OST interrupt is enabled in the core
  control unit.

properties:
  compatible:
    const: ingenic,t41-ost

  reg:
    items:
      - description: Global OST
      - description: Core OSTs, one window every 0x100 bytes

  reg-names:
    items:
      - const: global
      - const: core

  clocks:
    maxItems: 1

  clock-names:
    const: ost

  interrupts:
    maxItems: 1

required:
  - compatible
  - reg
  - reg-names
  - clocks
  - clock-names
  - interrupts

additionalProperties: false

examples:
  - |
    timer@12000000 {
        compatible = "ingenic,t41-ost";
        reg = <0x12000000 0x10000>, <0x12100000 0x10000>;
        reg-names = "global", "core";

        clocks = <&cgu 0>;
        clock-names = "ost";

        interrupt-parent = <&cpuintc>;
        interrupts = <4>;
    };
...
```

## Documentation/devicetree/bindings/ata/ingenic,a1-ahci.yaml
```yaml
# SPDX-License-Identifier: (GPL-2.0-only OR BSD-2-Clause)
%YAML 1.2
---
$id: http://devicetree.org/schemas/ata/ingenic,a1-ahci.yaml#
$schema: http://devicetree.org/meta-schemas/core.yaml#

title: Ingenic A1 AHCI SATA Controller

maintainers:
  - Alfonso Gamboa <gtxent@gmail.com>

description:
  The A1's two-port AHCI controller comes with an Innophy SATA PHY for each
  port, which the driver tunes before the host comes up.

allOf:
  - $ref: ahci-common.yaml#

properties:
  compatible:
    const: ingenic,a1-ahci

  reg:
    items:
      - description: AHCI registers
      - description: PHY of port 0
      - description: PHY of port 1

  reg-names:
    items:
      - const: ahci
      - const: phy0
      - const: phy1

  interrupts:
    maxItems: 1

  clocks:
    maxItems: 1

  ingenic,srbc:
    $ref: /schemas/types.yaml#/definitions/phandle
    description:
      Syscon of the CPM soft reset and bus control register, whose bit 18
      resets the controller.

required:
  - compatible
  - reg
  - reg-names
  - interrupts
  - clocks
  - ingenic,srbc

unevaluatedProperties: false

examples:
  - |
    #include <dt-bindings/clock/ingenic,a1-cgu.h>

    sata@130d0000 {
        compatible = "ingenic,a1-ahci";
        reg = <0x130d0000 0x10000>, <0x10080000 0x10000>, <0x10090000 0x10000>;
        reg-names = "ahci", "phy0", "phy1";
        interrupts = <43>;
        clocks = <&cgu A1_CLK_SATA>;
        ports-implemented = <0x3>;
        ingenic,srbc = <&srbc>;
    };
```

## Documentation/devicetree/bindings/iio/adc/ingenic,t31-sadc.yaml
```yaml
# SPDX-License-Identifier: (GPL-2.0-only OR BSD-2-Clause)
%YAML 1.2
---
$id: http://devicetree.org/schemas/iio/adc/ingenic,t31-sadc.yaml#
$schema: http://devicetree.org/meta-schemas/core.yaml#

title: Ingenic T-series SAR ADC

maintainers:
  - Alfonso Gamboa <gtxent@gmail.com>

description:
  The SAR ADC (SADC) of the Ingenic T-series SoCs converts up to eight
  auxiliary inputs with one 12-bit converter, a channel at a time. Packages
  bond out a subset of the inputs.

properties:
  compatible:
    oneOf:
      - enum:
          - ingenic,t20-sadc
          - ingenic,t21-sadc
          - ingenic,t23-sadc
          - ingenic,t30-sadc
          - ingenic,t31-sadc
          - ingenic,t32-sadc
          - ingenic,t40-sadc
      - items:
          - const: ingenic,t10-sadc
          - const: ingenic,t20-sadc
      - items:
          - const: ingenic,t33-sadc
          - const: ingenic,t32-sadc
      - items:
          - const: ingenic,t41-sadc
          - const: ingenic,t40-sadc

  reg:
    maxItems: 1

  interrupts:
    maxItems: 1

  clocks:
    maxItems: 1

  clock-names:
    const: adc

  vref-supply:
    description: The SADC_VREF reference input.

  '#io-channel-cells':
    const: 1

required:
  - compatible
  - reg
  - interrupts
  - clocks
  - clock-names
  - '#io-channel-cells'

additionalProperties: false

examples:
  - |
    #include <dt-bindings/clock/ingenic,t31-cgu.h>

    adc@10070000 {
        compatible = "ingenic,t31-sadc";
        reg = <0x10070000 0x30>;
        interrupts = <18>;
        clocks = <&cgu T31_CLK_SADC>;
        clock-names = "adc";
        #io-channel-cells = <1>;
    };
```

## Documentation/devicetree/bindings/interrupt-controller/ingenic,xburst2-intc.yaml
```yaml
# SPDX-License-Identifier: (GPL-2.0-only OR BSD-2-Clause)
%YAML 1.2
---
$id: http://devicetree.org/schemas/interrupt-controller/ingenic,xburst2-intc.yaml#
$schema: http://devicetree.org/meta-schemas/core.yaml#

title: Ingenic XBurst2 SoC interrupt controller

maintainers:
  - Alfonso Gamboa <gtxent@gmail.com>

description:
  The interrupt controller of the Ingenic XBurst2 SoCs has 64 sources and a
  register window of its own for every core, each with an independent mask.
  A source is delivered to the core in whose window it is unmasked, on that
  core's CPU interrupt pin 2, once the core's peripheral interrupt is enabled
  in the core control unit.

properties:
  $nodename:
    pattern: "^interrupt-controller@[0-9a-f]+$"

  compatible:
    const: ingenic,t41-intc

  reg:
    maxItems: 1
    description: The per-core windows, one every 0x100 bytes

  "#interrupt-cells":
    const: 1

  interrupt-controller: true

  interrupts:
    maxItems: 1

required:
  - compatible
  - reg
  - "#interrupt-cells"
  - interrupt-controller
  - interrupts

additionalProperties: false

examples:
  - |
    interrupt-controller@12300000 {
        compatible = "ingenic,t41-intc";
        reg = <0x12300000 0x200>;

        interrupt-controller;
        #interrupt-cells = <1>;

        interrupt-parent = <&cpuintc>;
        interrupts = <2>;
    };
...
```

## Documentation/devicetree/bindings/mips/ingenic/devices.yaml
```yaml
# SPDX-License-Identifier: (GPL-2.0-only OR BSD-2-Clause)
%YAML 1.2
---
$id: http://devicetree.org/schemas/mips/ingenic/devices.yaml#
$schema: http://devicetree.org/meta-schemas/core.yaml#

title: Ingenic XBurst based Platforms

maintainers:
  - 周琰杰 (Zhou Yanjie) <zhouyanjie@wanyeetech.com>

description:
  Devices with a Ingenic XBurst CPU shall have the following properties.

properties:
  $nodename:
    const: '/'
  compatible:
    oneOf:

      - description: Qi Hardware Ben NanoNote
        items:
          - const: qi,lb60
          - const: ingenic,jz4740

      - description: YLM RetroMini RS-90
        items:
          - const: ylm,rs90
          - const: ingenic,jz4725b

      - description: Game Consoles Worldwide GCW Zero
        items:
          - const: gcw,zero
          - const: ingenic,jz4770

      - description: MIPS Creator CI20
        items:
          - const: img,ci20
          - const: ingenic,jz4780

      - description: YSH & ATIL General Board, CU1000 Module with Neo Backplane
        items:
          - const: yna,cu1000-neo
          - const: ingenic,x1000e

      - description: YSH & ATIL General Board, CU1830 Module with Neo Backplane
        items:
          - const: yna,cu1830-neo
          - const: ingenic,x1830

      - description: YSH & ATIL General Board, CU2000 Module with Neo Backplane
        items:
          - const: yna,cu2000-neo
          - const: ingenic,x2000e

      - description: Thingino board for the Ingenic T10
        items:
          - const: thingino,t10
          - const: ingenic,t10

      - description: Thingino board for the Ingenic T20
        items:
          - const: thingino,t20
          - const: ingenic,t20

      - description: Thingino board for the Ingenic T21
        items:
          - const: thingino,t21
          - const: ingenic,t21

      - description: Thingino board for the Ingenic T23
        items:
          - const: thingino,t23
          - const: ingenic,t23

      - description: Thingino board for the Ingenic T30
        items:
          - const: thingino,t30
          - const: ingenic,t30

      - description: Thingino generic board for the Ingenic T31
        items:
          - const: thingino,t31
          - const: ingenic,t31

      - description: Thingino generic board for the Ingenic T32
        items:
          - const: thingino,t32
          - const: ingenic,t32

      - description: Cinnado D1 camera with the Ingenic T32LQ
        items:
          - const: thingino,t32-cinnado-d1
          - const: thingino,t32
          - const: ingenic,t32

      - description: Thingino generic board for the Ingenic T33
        items:
          - const: thingino,t33
          - const: ingenic,t33

      - description: Thingino generic board for the Ingenic T41
        items:
          - const: thingino,t41
          - const: ingenic,t41

additionalProperties: true

...
```

## Documentation/devicetree/bindings/mips/ingenic/ingenic,xburst2-ccu.yaml
```yaml
# SPDX-License-Identifier: (GPL-2.0-only OR BSD-2-Clause)
%YAML 1.2
---
$id: http://devicetree.org/schemas/mips/ingenic/ingenic,xburst2-ccu.yaml#
$schema: http://devicetree.org/meta-schemas/core.yaml#

title: Ingenic XBurst2 core control unit

maintainers:
  - Alfonso Gamboa <gtxent@gmail.com>

description:
  The core control unit (CCU) of the XBurst2 multi-core CPU holds the
  per-core software reset and reset entry address, the per-core masks of the
  peripheral, mailbox and OST interrupts, and one mailbox register per core.
  The kernel starts the secondary cores through the reset registers and sends
  inter-processor interrupts through the mailboxes.

properties:
  compatible:
    const: ingenic,xburst2-ccu

  reg:
    maxItems: 1

  interrupts:
    maxItems: 1
    description: The CPU interrupt pin of the mailbox interrupt (pin 3)

required:
  - compatible
  - reg
  - interrupts

additionalProperties: false

examples:
  - |
    cpu-control@12200000 {
        compatible = "ingenic,xburst2-ccu";
        reg = <0x12200000 0x2000>;

        interrupt-parent = <&cpuintc>;
        interrupts = <3>;
    };
...
```

## Documentation/devicetree/bindings/misc/ingenic,a1-aip.yaml
```yaml
# SPDX-License-Identifier: (GPL-2.0-only OR BSD-2-Clause)
%YAML 1.2
---
$id: http://devicetree.org/schemas/misc/ingenic,a1-aip.yaml#
$schema: http://devicetree.org/meta-schemas/core.yaml#

title: Ingenic A1 and T41 AI preprocessor (AIP)

maintainers:
  - Alfonso Gamboa <gtxent@gmail.com>

description:
  Three image engines for the NNA's input, each with its own interrupt,
  T (format conversion) at +0x000, F (resize) at +0x200 and P (affine and
  perspective warps) at +0x300.

properties:
  compatible:
    enum:
      - ingenic,a1-aip
      - ingenic,t41-aip

  reg:
    maxItems: 1

  interrupts:
    items:
      - description: T engine
      - description: F engine
      - description: P engine

  clocks:
    maxItems: 1

  clock-names:
    const: gate_aip

required:
  - compatible
  - reg
  - interrupts

allOf:
  - if:
      properties:
        compatible:
          const: ingenic,a1-aip
    then:
      required:
        - clocks
        - clock-names
    else:
      properties:
        clocks: false
        clock-names: false

additionalProperties: false

examples:
  - |
    aip@12b00000 {
        compatible = "ingenic,t41-aip";
        reg = <0x12b00000 0x400>;
        interrupts = <40>, <39>, <38>;
    };
```

## Documentation/devicetree/bindings/misc/ingenic,t32-tnpu.yaml
```yaml
# SPDX-License-Identifier: (GPL-2.0-only OR BSD-2-Clause)
%YAML 1.2
---
$id: http://devicetree.org/schemas/misc/ingenic,t32-tnpu.yaml#
$schema: http://devicetree.org/meta-schemas/core.yaml#

title: Ingenic T32, T32 Pro and T33 TNPU

maintainers:
  - Alfonso Gamboa <gtxent@gmail.com>

description:
  A RISC-V core with its own control block and RAM that runs the kernels of
  a neural network model, driving the TNPU's convolution engine and DMA. The
  host loads its boot code, queues tasks in the RAM's mailbox and takes one
  interrupt per finished task.

  The T32 Pro's TNPU is a later design with two such cores, a control block
  four times larger with a register block per core, and a larger RAM that
  sits apart from the control block.

properties:
  compatible:
    oneOf:
      - const: ingenic,t32-tnpu
      - const: ingenic,t32pro-tnpu
      - items:
          - const: ingenic,t33-tnpu
          - const: ingenic,t32-tnpu

  reg:
    items:
      - description: control (CCU) registers
      - description: boot code and task mailbox RAM

  reg-names:
    items:
      - const: ccu
      - const: dram

  interrupts:
    maxItems: 1

  clocks:
    minItems: 1
    items:
      - description: TNPU clock
      - description: SCLKA, a parent of the TNPU clock
      - description: MPLL, a parent of the TNPU clock
      - description: VPLL, a parent of the TNPU clock

  clock-names:
    minItems: 1
    items:
      - const: tnpu
      - const: sclka
      - const: mpll
      - const: vpll

required:
  - compatible
  - reg
  - reg-names
  - interrupts
  - clocks
  - clock-names

additionalProperties: false

examples:
  - |
    #include <dt-bindings/clock/ingenic,t32-cgu.h>

    npu@12700000 {
        compatible = "ingenic,t32-tnpu";
        reg = <0x12700000 0x1000>, <0x12608000 0x1000>;
        reg-names = "ccu", "dram";
        interrupts = <0>;
        clocks = <&cgu T32_CLK_TNPU>, <&cgu T32_CLK_SCLKA>,
                 <&cgu T32_CLK_MPLL>, <&cgu T32_CLK_VPLL>;
        clock-names = "tnpu", "sclka", "mpll", "vpll";
    };
```

## Documentation/devicetree/bindings/misc/ingenic,t40-bscaler.yaml
```yaml
# SPDX-License-Identifier: (GPL-2.0-only OR BSD-2-Clause)
%YAML 1.2
---
$id: http://devicetree.org/schemas/misc/ingenic,t40-bscaler.yaml#
$schema: http://devicetree.org/meta-schemas/core.yaml#

title: Ingenic T40 BSCALER

maintainers:
  - Alfonso Gamboa <gtxent@gmail.com>

description:
  The T40's image scaler and converter for the NNA's input, in the window
  it shares with the LZMA decompressor. FRMT converts NV12 frames, FRMC
  resizes and warps through descriptor chains.

properties:
  compatible:
    const: ingenic,t40-bscaler

  reg:
    maxItems: 1

  interrupts:
    items:
      - description: FRMT
      - description: FRMC

  interrupt-names:
    items:
      - const: frmt
      - const: frmc

  clocks:
    items:
      - description: BSCALER clock
      - description: AHB0 bus gate

  clock-names:
    items:
      - const: bscaler
      - const: ahb0

required:
  - compatible
  - reg
  - interrupts
  - interrupt-names
  - clocks
  - clock-names

additionalProperties: false

examples:
  - |
    #include <dt-bindings/clock/ingenic,t40-cgu.h>

    bscaler@13090000 {
        compatible = "ingenic,t40-bscaler";
        reg = <0x13090000 0x100>;
        interrupts = <40>, <39>;
        interrupt-names = "frmt", "frmc";
        clocks = <&cgu T40_CLK_BSCALER>, <&cgu T40_CLK_AHB0>;
        clock-names = "bscaler", "ahb0";
    };
```

## Documentation/devicetree/bindings/misc/ingenic,t40-nna.yaml
```yaml
# SPDX-License-Identifier: (GPL-2.0-only OR BSD-2-Clause)
%YAML 1.2
---
$id: http://devicetree.org/schemas/misc/ingenic,t40-nna.yaml#
$schema: http://devicetree.org/meta-schemas/core.yaml#

title: Ingenic T40, T41 and A1 neural network accelerator (NNA)

maintainers:
  - Alfonso Gamboa <gtxent@gmail.com>

description:
  The NNA is driven by the CPU's MXU3 NN instructions; its DMA moves data
  between memory and the ORAM, the part of an on-chip SRAM that the L2
  cache does not use (the CCU sets the split). User space maps the DMA and
  descriptor window, the ORAM and an nmem= region through the device.

properties:
  compatible:
    enum:
      - ingenic,a1-nna
      - ingenic,t40-nna
      - ingenic,t41-nna

  reg:
    items:
      - description: NN DMA registers and descriptor RAM
      - description: SRAM shared by the L2 cache and the ORAM

  reg-names:
    items:
      - const: nndma
      - const: sram

required:
  - compatible
  - reg
  - reg-names

additionalProperties: false

examples:
  - |
    nna@12500000 {
        compatible = "ingenic,t41-nna";
        reg = <0x12500000 0x10000>, <0x12600000 0x80000>;
        reg-names = "nndma", "sram";
    };
```

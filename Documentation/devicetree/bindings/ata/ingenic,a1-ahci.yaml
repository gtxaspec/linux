## arch/mips/ingenic/Kconfig
```kconfig
# SPDX-License-Identifier: GPL-2.0

config MACH_INGENIC_GENERIC
	bool
	select MACH_INGENIC
	select MACH_JZ4740
	select MACH_JZ4725B
	select MACH_JZ4770
	select MACH_JZ4780
	select MACH_X1000
	select MACH_X1830
	select MACH_A1
	select MACH_T10
	select MACH_T20
	select MACH_T21
	select MACH_T23
	select MACH_T30
	select MACH_T31
	select MACH_T32
	select MACH_T33
	select MACH_T40
	select MACH_T41

choice
	prompt "Machine type"
	depends on MACH_INGENIC_SOC
	default INGENIC_GENERIC_BOARD

config INGENIC_GENERIC_BOARD
	bool "Generic board"
	select MACH_INGENIC_GENERIC

config JZ4740_QI_LB60
	bool "Qi Hardware Ben NanoNote"
	select MACH_JZ4740

config JZ4740_RS90
	bool "YLM RetroMini (RS-90)"
	select MACH_JZ4725B

config JZ4770_GCW0
	bool "Game Consoles Worldwide GCW Zero"
	select MACH_JZ4770

config JZ4780_CI20
	bool "MIPS Creator CI20"
	select MACH_JZ4780

config X1000_CU1000_NEO
	bool "YSH & ATIL CU1000 Module with Neo backplane"
	select MACH_X1000

config X1830_CU1830_NEO
	bool "YSH & ATIL CU1830 Module with Neo backplane"
	select MACH_X1830

endchoice

config BUILTIN_DTB_NAME
	string "Source file for built-in DTB"
	depends on MACH_INGENIC_SOC && BUILTIN_DTB
	help
	  Base name (without suffix, relative to arch/mips/boot/dts) of the
	  DTS file to link into the kernel. The kernel boots the first
	  built-in DTB, so a kernel that supports several SoCs names the one
	  it boots here. Leave empty to link every DTB the configuration
	  builds.

config MACH_JZ4725B
	bool
	select SYS_HAS_CPU_MIPS32_R1

config MACH_JZ4740
	bool
	select SYS_HAS_CPU_MIPS32_R1

config MACH_JZ4770
	bool
	select MIPS_CPU_SCACHE
	select SYS_HAS_CPU_MIPS32_R2
	select SYS_SUPPORTS_HIGHMEM

config MACH_JZ4780
	bool
	select MIPS_CPU_SCACHE
	select SYS_HAS_CPU_MIPS32_R2
	select SYS_SUPPORTS_HIGHMEM

config MACH_X1000
	bool
	select MIPS_CPU_SCACHE
	select SYS_HAS_CPU_MIPS32_R2
	select SYS_SUPPORTS_HIGHMEM

config MACH_X1830
	bool
	select MIPS_CPU_SCACHE
	select SYS_HAS_CPU_MIPS32_R2
	select SYS_SUPPORTS_HIGHMEM

config MACH_T10
	bool
	select MIPS_CPU_SCACHE
	select SYS_HAS_CPU_MIPS32_R2
	select SYS_SUPPORTS_HIGHMEM

config MACH_T20
	bool
	select MIPS_CPU_SCACHE
	select SYS_HAS_CPU_MIPS32_R2
	select SYS_SUPPORTS_HIGHMEM

config MACH_T21
	bool
	select MIPS_CPU_SCACHE
	select SYS_HAS_CPU_MIPS32_R2
	select SYS_SUPPORTS_HIGHMEM

config MACH_T23
	bool
	select MIPS_CPU_SCACHE
	select SYS_HAS_CPU_MIPS32_R2
	select SYS_SUPPORTS_HIGHMEM

config MACH_T30
	bool
	select MIPS_CPU_SCACHE
	select SYS_HAS_CPU_MIPS32_R2
	select SYS_SUPPORTS_HIGHMEM

config MACH_T31
	bool
	select MIPS_CPU_SCACHE
	select SYS_HAS_CPU_MIPS32_R2
	select SYS_SUPPORTS_HIGHMEM

config MACH_T32
	bool
	select MIPS_CPU_SCACHE
	select SYS_HAS_CPU_MIPS32_R2
	select SYS_SUPPORTS_HIGHMEM

config MACH_T33
	bool
	select MIPS_CPU_SCACHE
	select SYS_HAS_CPU_MIPS32_R2
	select SYS_SUPPORTS_HIGHMEM

config MACH_A1
	bool
	select MIPS_CPU_SCACHE
	select SYS_HAS_CPU_MIPS32_R2
	select SYS_SUPPORTS_HIGHMEM
	select SYS_SUPPORTS_SMP

config MACH_T40
	bool
	select MIPS_CPU_SCACHE
	select SYS_HAS_CPU_MIPS32_R2
	select SYS_SUPPORTS_HIGHMEM
	select SYS_SUPPORTS_SMP

config MACH_T41
	bool
	select MIPS_CPU_SCACHE
	select SYS_HAS_CPU_MIPS32_R2
	select SYS_SUPPORTS_HIGHMEM
	select SYS_SUPPORTS_SMP

config INGENIC_XBURST2_SMP
	bool
	depends on (MACH_A1 || MACH_T40 || MACH_T41) && SMP
	default y
	help
	  Starts the second core of the XBurst2 CPU (A1, T40, T41) through the core
	  control unit and sends it inter-processor interrupts through the
	  CCU mailboxes. CPU hotplug is not supported.

config INGENIC_XBURST_MXU2
	bool "XBurst MXU2 SIMD unit"
	depends on MACH_T10 || MACH_T20 || MACH_T21 || MACH_T23 || MACH_T30 || MACH_T31 || \
		   MACH_T32 || MACH_T33
	default y
	help
	  Lets user space use the 128-bit MXU2 SIMD unit (coprocessor 2) of
	  the XBurst1 cores in the Ingenic T-series. A task gets the unit on
	  its first MXU2 instruction and the kernel saves its registers across
	  context switches. Parts without a usable MXU2 (T21, T23) are found
	  at boot and keep raising SIGILL.

config INGENIC_TX_ISP_DEPS
	tristate "Kernel support for the out-of-tree Ingenic tx-isp driver"
	depends on MEDIA_CONTROLLER && VIDEO_DEV
	select VIDEO_V4L2_SUBDEV_API
	select VIDEOBUF2_CORE
	select VIDEOBUF2_V4L2
	select VIDEOBUF2_MEMOPS
	help
	  The T10/T20 tx-isp driver and its helix encoder client are built out
	  of tree against this kernel and use videobuf2, which no in-tree
	  driver selects on these SoCs. Say M to build the videobuf2 modules
	  they load.
```
